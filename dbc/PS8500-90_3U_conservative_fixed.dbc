VERSION ""

NS_ :

BS_:

BU_:

BO_ 2 Read_Object: 43 PS8500_90
 SG_ Alarm_Code_1 : 335|8@1+ (1,0) [0|0] ""  PC
 SG_ Alarm_Type_1 : 327|8@1+ (1,0) [0|0] ""  PC
 SG_ Alarm_Code_2 : 319|8@1+ (1,0) [0|0] ""  PC
 SG_ Alarm_Type_2 : 311|8@1+ (1,0) [0|0] ""  PC
 SG_ Alarm_Code_0 : 303|8@1+ (1,0) [0|0] ""  PC
 SG_ Alarm_Type_0 : 295|8@1+ (1,0) [0|0] ""  PC
 SG_ Last_Com_Errror : 287|8@1+ (1,0) [0|0] ""  PC
 SG_ Actual_Power : 271|16@1+ (0.5859375,0) [0|15000] "W"  PC
 SG_ Read_Power_Act : 255|16@1+ (0.5859375,0) [0|15000] "W"  PC
 SG_ Actual_Current : 239|16@1+ (0.003515625,0) [0|90] "A"  PC
 SG_ Read_Current_Act : 223|16@1+ (0.003515625,0) [0|90] "A"  PC
 SG_ Actual_Voltage : 207|16@1+ (0.01953125,0) [0|500] "V"  PC
 SG_ Read_OVP : 191|16@1+ (0.01953125,0) [0|550] "V"  PC
 SG_ Read_UVL : 175|16@1+ (0.01953125,0) [0|500] "V"  PC
 SG_ Read_Current : 159|16@1+ (0.003515625,0) [0|90] "A"  PC
 SG_ Read_Power : 143|16@1+ (0.5859375,0) [0|15000] "W"  PC
 SG_ Read_Voltage : 127|16@1+ (0.01953125,0) [0|500] "V"  PC
 SG_ Read_Voltage_Act : 111|16@1+ (0.01953125,0) [0|500] "V"  PC
 SG_ Nom_Current : 79|32@1- (1,0) [0|0] "A"  PC
 SG_ Nom_Power : 47|32@1- (1,0) [0|0] "W"  PC
 SG_ Nom_Voltage : 15|32@1- (1,0) [0|0] "V"  PC
 SG_ Read_Mux : 7|8@1+ (1,0) [0|0] ""  PC
 SG_ Status_Output : 6|1@1+ (1,0) [0|0] ""  PC
 SG_ Status_Alarm : 5|1@1+ (1,0) [0|0] ""  PC
 SG_ Status_Menu : 4|1@1+ (1,0) [0|0] ""  PC
 SG_ Status_Reg_Act : 2|2@1+ (1,0) [0|0] ""  PC
 SG_ Status_Access : 0|2@1+ (1,0) [0|0] ""  PC

BO_ 1 Query_Object: 8 PC
 SG_ Query_Mux : 7|8@1+ (1,0) [0|0] ""  PS8500_90

BO_ 0 Send_Object: 13 PC
 SG_ Send_Control_Mask : 95|8@1+ (1,0) [0|0] ""  PS8500_90
 SG_ Send_OVP : 79|16@1+ (0.01953125,0) [0|550] "V"  PS8500_90
 SG_ Send_Power : 63|16@1+ (0.5859375,0) [0|15000] "W"  PS8500_90
 SG_ Send_UVL : 47|16@1+ (0.01953125,0) [0|500] "V"  PS8500_90
 SG_ Send_Voltage : 31|16@1+ (0.01953125,0) [0|500] "V"  PS8500_90
 SG_ Send_Current : 15|16@1+ (0.003515625,0) [0|90] "A"  PS8500_90
 SG_ Send_Mux : 7|8@1+ (1,0) [0|0] ""  PS8500_90
 SG_ Send_Control_Output : 1|1@1+ (1,0) [0|0] ""  PS8500_90
 SG_ Send_Control_Remote : 0|1@1+ (1,0) [0|0] ""  PS8500_90
