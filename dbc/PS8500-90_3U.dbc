VERSION ""

NS_ :

BS_:

BU_: PC PS8500_90
VAL_TABLE_ On_Off 1 "on" 0 "off" ;

BO_ 2 Read_Object: 8 PS8500_90
 SG_ Read_Current_Act m72 : 31|16@0+ (0.003515625,0) [0|90] "A"  PC
 SG_ Read_Voltage_Act m72 : 15|16@0+ (0.01953125,0) [0|500] "V"  PC
 SG_ Read_Power_Act m72 : 47|16@0+ (0.5859375,0) [0|15000] "W"  PC
 SG_ Read_Voltage m50 : 15|16@0+ (0.01953125,0) [0|500] "V"  PC
 SG_ Read_Power m52 : 15|16@0+ (0.5859375,0) [0|15000] "W"  PC
 SG_ Read_Current m51 : 15|16@0+ (0.003515625,0) [0|90] "A"  PC
 SG_ Read_UVL m37 : 15|16@0+ (0.01953125,0) [0|500] "V"  PC
 SG_ Read_OVP m38 : 15|16@0+ (0.01953125,0) [0|550] "V"  PC
 SG_ Last_Com_Errror m255 : 15|8@0+ (1,0) [0|0] ""  PC
 SG_ Nom_Voltage m2 : 15|32@0- (1,0) [0|0] "V"  PC
 SG_ Status_Alarm m70 : 20|1@0+ (1,0) [0|0] ""  PC
 SG_ Status_Reg_Act m70 : 18|2@0+ (1,0) [0|0] ""  PC
 SG_ Status_Output m70 : 16|1@0+ (1,0) [0|0] ""  PC
 SG_ Status_Menu m70 : 15|1@0+ (1,0) [0|0] ""  PC
 SG_ Status_Access m70 : 9|2@0+ (1,0) [0|0] ""  PC
 SG_ Nom_Power m4 : 15|32@0- (1,0) [0|0] "W"  PC
 SG_ Nom_Current m3 : 15|32@0- (1,0) [0|0] "A"  PC
 SG_ Alarm_Type_0 m77 : 15|8@0+ (1,0) [0|0] ""  PC
 SG_ Alarm_Type_2 m77 : 31|8@0+ (1,0) [0|0] ""  PC
 SG_ Alarm_Type_1 m77 : 47|8@0+ (1,0) [0|0] ""  PC
 SG_ Alarm_Code_0 m77 : 23|8@0+ (1,0) [0|0] ""  PC
 SG_ Alarm_Code_2 m77 : 39|8@0+ (1,0) [0|0] ""  PC
 SG_ Alarm_Code_1 m77 : 55|8@0+ (1,0) [0|0] ""  PC
 SG_ Actual_Voltage m71 : 15|16@0+ (0.01953125,0) [0|500] "V"  PC
 SG_ Actual_Power m71 : 47|16@0+ (0.5859375,0) [0|15000] "W"  PC
 SG_ Actual_Current m71 : 31|16@0+ (0.003515625,0) [0|90] "A"  PC
 SG_ Read_Mux M : 7|8@0+ (1,0) [0|0] ""  PC

BO_ 1 Query_Object: 1 PC
 SG_ Query_Mux : 7|8@0+ (1,0) [0|0] ""  PS8500_90

BO_ 0 Send_Object: 8 PC
 SG_ Send_Current m51 : 15|16@0+ (0.003515625,0) [0|90] "A"  PS8500_90
 SG_ Send_Voltage m50 : 15|16@0+ (0.01953125,0) [0|500] "V"  PS8500_90
 SG_ Send_UVL m37 : 15|16@0+ (0.01953125,0) [0|500] "V"  PS8500_90
 SG_ Send_Power m52 : 15|16@0+ (0.5859375,0) [0|15000] "W"  PS8500_90
 SG_ Send_OVP m38 : 15|16@0+ (0.01953125,0) [0|550] "V"  PS8500_90
 SG_ Send_Control_Remote m54 : 20|1@0+ (1,0) [0|0] ""  PS8500_90
 SG_ Send_Control_Mask m54 : 15|8@0+ (1,0) [0|0] ""  PS8500_90
 SG_ Send_Control_Output m54 : 16|1@0+ (1,0) [0|0] ""  PS8500_90
 SG_ Send_Mux M : 7|8@0+ (1,0) [0|0] ""  PS8500_90

VAL_ 2 Last_Com_Errror 56 "Object access not possible" 49 "Lower limit of object exceeded" 48 "Upper limit of object exceeded" 20 "CAN driver buffer full" 18 "CAN transmission error" 17 "CAN CRC error" 16 "CAN stuffing error" 15 "Device is in local" 13 "Message buffer overflow" 9 "Read/write law hurt, no access" 8 "Wrong object length" 7 "Object unknown" 0 "No error" ;
VAL_ 2 Status_Alarm 1 "Alarm" 0 "No alarm" ;
VAL_ 2 Status_Reg_Act 3 "CP" 2 "CC" 0 "CV" ;
VAL_ 2 Status_Output 1 "On" 0 "Off" ;
VAL_ 2 Status_Menu 1 "Menu" 0 "No menu" ;
VAL_ 2 Status_Access 3 "Local" 2 "External" 1 "Remote" 0 "Free" ;
VAL_ 2 Alarm_Type_0 2 "Alarm gone" 1 "Alarm active" 0 "No alarm" ;
VAL_ 2 Alarm_Type_2 2 "Alarm gone" 1 "Alarm active" 0 "No alarm" ;
VAL_ 2 Alarm_Type_1 2 "Alarm gone" 1 "Alarm active" 0 "No alarm" ;
VAL_ 2 Alarm_Code_0 28 "PF" 2 "OT" 1 "OVP" 0 "No alarm" ;
VAL_ 2 Alarm_Code_2 28 "PF" 1 "OVP" 0 "No alarm" ;
VAL_ 2 Alarm_Code_1 28 "PF" 1 "OVP" 0 "No alarm" ;
VAL_ 2 Read_Mux 72 "Momentary set values U, I, P" 38 "OVP threshold" 77 "Alarms" 71 "Actual values U, I, P" 70 "Device status" 54 "Control" 52 "Set value P" 51 "Set value I" 50 "Set value U" 37 "Undervoltage adjustment limit" 19 "Device class" 4 "Nominal power" 3 "Nominal current" 2 "Nominal voltage" ;
VAL_ 1 Query_Mux 72 "Momentary set values U, I, P" 38 "OVP threshold" 77 "Alarms" 71 "Actual values U, I, P" 70 "Device status" 54 "Control" 52 "Set value P" 51 "Set value I" 50 "Set value U" 37 "Undervoltage adjustment limit" 19 "Device class" 4 "Nominal power" 3 "Nominal current" 2 "Nominal voltage" ;
VAL_ 0 Send_Control_Remote 1 "on" 0 "off" ;
VAL_ 0 Send_Control_Mask 16 "Remote" 1 "Output" ;
VAL_ 0 Send_Control_Output 1 "on" 0 "off" ;
VAL_ 0 Send_Mux 37 "Undervoltage threshold" 52 "Output power" 51 "Output current" 50 "Output voltage" 38 "OVP threshold" 54 "Control" ;
SIG_GROUP_ 2 Read_Actual_Values 1 : Actual_Voltage Actual_Power Actual_Current;
SIG_GROUP_ 2 Read_Alarms 1 : Alarm_Type_0 Alarm_Type_2 Alarm_Type_1 Alarm_Code_0 Alarm_Code_2 Alarm_Code_1;
SIG_GROUP_ 2 Read_Status 1 : Last_Com_Errror Status_Access Status_Menu Status_Output Status_Reg_Act Status_Alarm;
SIG_GROUP_ 2 Read_Set_Values 1 : Read_Current_Act Read_Voltage_Act Read_Power_Act Read_OVP Read_UVL Read_Current Read_Power Read_Voltage;
SIG_GROUP_ 0 Send_Set_Values 1 : Send_OVP Send_Power Send_UVL Send_Voltage Send_Current;
SIG_GROUP_ 0 Send_Device_Control 1 : Send_Control_Remote Send_Control_Output Send_Control_Mask;
SIG_VALTYPE_ 2 Nom_Voltage : 1;
SIG_VALTYPE_ 2 Nom_Power : 1;
SIG_VALTYPE_ 2 Nom_Current : 1;
