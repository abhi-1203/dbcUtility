VERSION ""

NS_ :

BS_:

BU_:

BO_ 2364540158 EEC1: 8 VCU
 SG_ example : 0|1@1+ (1,0) [0.0|0.0] "" Vector__XXX

BO_ 2566844926 CCVS1: 8 Vector__XXX

CM_ BO_ 2364540158 "Electronic Engine Controller 1";
CM_ BO_ 2566844926 "Cruise Control/Vehicle Speed 1";
